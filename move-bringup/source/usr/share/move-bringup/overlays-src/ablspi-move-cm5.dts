// SPDX-License-Identifier: GPL-2.0-or-later
/*
 * ablspi-move-cm5.dts - Device-tree overlay porting the Ableton Move's
 * CM4-era custom bindings forward to Raspberry Pi Compute Module 5 (BCM2712 + RP1).
 *
 * On CM5 the carrier-facing GPIO/SPI/I²C peripherals live on the RP1
 * southbridge (PCIe-attached), not on the BCM2712 SoC. The Pi firmware
 * and upstream rpi linux already expose RP1 controllers under stable DT
 * labels and pre-canned pinctrl groups, so the SPI/ablspi portion of
 * the overlay reduces to:
 *
 *   - &spi0 -> RP1 spi0 (/axi/pcie@.../rp1/spi@50000). CS0 is wired to
 *     physical SODIMM GPIO 8 in the base DTB's cs-gpios, matching
 *     CM4 BCM2711 spi0 — i.e. the XMOS is on the same physical CS pin
 *     and the ablspi-dkms driver binds cleanly via compatible="ablspi".
 *     &gpio -> RP1 gpio bank; ablspi IRQ on SODIMM GPIO 3 resolves to
 *     the same physical pin as on CM4.
 *
 *   - Verified on hardware: /dev/ablspi0.0 appears, MoveLauncher binds,
 *     XMOS handshake completes. CM5 ablspi works equivalently to CM4.
 *
 * ──── RTC (PCF85063) is HARDWARE-INCOMPATIBLE with CM5 ────
 *
 * No RTC fragment ships here on purpose. The Move's PCF85063 is hardwired
 * on the carrier to the SODIMM pins originally labelled "GPIO 44/45".
 * On CM4 (BCM2711) those SODIMM pins map to BCM2711 GPIO 44/45 which
 * has I²C as an alt function (the CM4 overlay uses &i2c0if + pinctrl
 * &i2c0_gpio44 and it works). On CM5 those same SODIMM pins map to
 * BCM2712-internal pads named "emmc_dat5" / "emmc_dat6" (pin 44/45 in
 * the bcm2712 pinctrl namespace) — and per the rpi-6.12.y/rpi-7.0.y
 * kernel pinctrl driver (drivers/pinctrl/bcm/pinctrl-bcm2712.c), those
 * pads have ZERO I²C alt-functions:
 *
 *     PIN(44, vc_spi0, mtsif_alt, enet0, sd_card_a, mtsif_alt1,
 *         arm_jtag, pdm, spi_m),
 *     PIN(45, vc_spi0, mtsif_alt, enet0, sd_card_a, mtsif_alt1,
 *         arm_jtag, pdm, spi_m),
 *
 * The BCM2712 SODIMM pins that DO expose I²C (function bsc_m3, alt5)
 * are GPIO 40/41 — physically different SODIMM pins from where the
 * Move carrier traced the RTC. There is no software workaround; this
 * is the same kind of hardware-level pin repurposing called out in
 * §"CM4 ↔ CM5 differences" of the CM5 datasheet.
 *
 * Options for RTC on a CM5 Move:
 *   (a) Hardware mod: cut the RTC SDA/SCL traces, jumper them to the
 *       SODIMM pins that map to GPIO 40/41 on CM5, and add a fragment
 *       targeting one of the BCM2712 i2c@7d005xxx nodes with pinctrl
 *       on bcm2712 pins 40/41 in function bsc_m3.
 *   (b) Live with no battery-backed RTC; rely on systemd-timesyncd /
 *       chrony to sync time over WiFi/Ethernet at boot. Time-of-day is
 *       lost across full power-off until the network comes up.
 *
 * The Move userspace tolerates option (b) — Set/UserData timestamps
 * just walk forward from epoch until NTP corrects them. If you have a
 * CM5 Move that needs persistent time-of-day, talk about option (a).
 *
 * ──── dwc2 / USB-OTG ────
 *
 * config.txt under [cm5] still ships `dtoverlay=dwc2,dr_mode=otg`.
 * The BCM2712 dwc2 controller at /axi/usb@480000 has compatible
 * "brcm,bcm2835-usb" so the stock dwc2.dtbo applies — BUT on the
 * Armbian rpi-7.0.y kernel as built, dwc2 stays deferred indefinitely
 * because the firmware-clock driver fails at boot (raspberrypi-clk
 * soc@107c000000:firmware:clocks: probe ... -22), so pm_genpd can't
 * power the USB controller (genpd_provider USB: Failed to set power
 * to 1 (-22)). That's an Armbian-kernel-build issue, not a DT one;
 * move-usb-gadget.service uses ConditionPathExistsGlob=/sys/class/udc/*
 * so it cleanly no-ops on CM5 instead of failing noisily.
 *
 * Build:   dtc -@ -I dts -O dtb -o ablspi-move-cm5.dtbo ablspi-move-cm5.dts
 * Install: copy to /boot/firmware/overlays/ then add
 *              dtoverlay=ablspi-move-cm5
 *          to /boot/firmware/config.txt under [cm5].
 */

/dts-v1/;
/plugin/;

/ {
	compatible = "raspberrypi,5-compute-module", "brcm,bcm2712";

	fragment@0 {
		target-path = "/";
		__overlay__ {
			compatible = "ableton,move", "raspberrypi,5-compute-module",
				     "brcm,bcm2712";
			model = "Ableton Move (CM5)";
		};
	};

	/*
	 * SPI0 (RP1): ablspi on CS0, nothing on CS1. We delete the upstream
	 * spidev children the base DTB attaches so our ablspi binding wins
	 * regardless of overlay load order.
	 */
	fragment@1 {
		target = <&spi0>;
		__overlay__ {
			#address-cells = <1>;
			#size-cells = <0>;
			status = "okay";

			/delete-node/ spidev@0;
			/delete-node/ spidev@1;

			ablspi: ablspi@0 {
				compatible = "ablspi";
				reg = <0>;
				spi-max-frequency = <125000000>;

				/*
				 * Modern descriptor-based GPIO binding. &gpio
				 * resolves to RP1's gpio controller; GPIO 3
				 * is the same physical SODIMM pin as on CM4.
				 */
				irq-gpios = <&gpio 3 0>;
			};

			ablspi_cs1: spidev@1 {
				compatible = "spidev";
				reg = <1>;
				spi-max-frequency = <125000000>;
				status = "disabled";
			};
		};
	};

	__overrides__ {
		ablspi_max_hz = <&ablspi>,"spi-max-frequency:0";
	};
};
